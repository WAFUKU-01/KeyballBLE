/ {
    behaviors {
        fb_base: fallback_to_base {
            compatible = "zmk,behavior-macro";
            label = "FB_BASE";
            #binding-cells = <1>;

            bindings = <
                &to 0
                &kp
            >;
        };
    };
};
